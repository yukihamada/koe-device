## firmware/amp/sdkconfig.defaults
```kconfig
CONFIG_ESP_TASK_WDT_EN=n
CONFIG_FREERTOS_HZ=1000
CONFIG_ESP32S3_DEFAULT_CPU_FREQ_240=y
CONFIG_SPIRAM=y
CONFIG_SPIRAM_MODE_OCT=y
CONFIG_ESP_MAIN_TASK_STACK_SIZE=65536
CONFIG_MBEDTLS_CERTIFICATE_BUNDLE_DEFAULT_FULL=y
CONFIG_ESP_TLS_INSECURE=y
CONFIG_ESP_TLS_SKIP_SERVER_CERT_VERIFY=y
```

## firmware/demo/sdkconfig.defaults
```kconfig
# WiFi
CONFIG_ESP_WIFI_ENABLED=y

# lwIP - enable multicast
CONFIG_LWIP_IGMP=y
CONFIG_LWIP_SO_RCVBUF=y
CONFIG_LWIP_NETIF_LOOPBACK=y

# I2S
CONFIG_SOC_I2S_SUPPORTED=y

# Timer (microsecond)
CONFIG_ESP_TIMER_TASK_STACK_SIZE=4096

# Larger stack for main task
CONFIG_ESP_MAIN_TASK_STACK_SIZE=8192
CONFIG_PTHREAD_TASK_STACK_SIZE_DEFAULT=4096
```

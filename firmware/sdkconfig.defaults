## firmware/sdkconfig.defaults
```kconfig
# ESP-IDF sdkconfig for Koe Device (ESP32-S3)

# Flash / PSRAM
CONFIG_ESPTOOLPY_FLASHSIZE_4MB=y
CONFIG_SPIRAM=y
CONFIG_SPIRAM_MODE_OCT=y
CONFIG_SPIRAM_SPEED_80M=y

# I2S DMA 低遅延チューニング
# buf_count=2, buf_len=32 → バッファ遅延 0.67ms (デフォルト 6×128=2.67ms)
CONFIG_I2S_ISR_IRAM_SAFE=y
CONFIG_I2S_DMA_BUFFER_COUNT=2
CONFIG_I2S_DMA_BUFFER_MAX_SIZE=32

# Network
CONFIG_ESP_WIFI_STATIC_RX_BUFFER_NUM=10
CONFIG_ESP_WIFI_DYNAMIC_RX_BUFFER_NUM=32
CONFIG_LWIP_IP4_REASSEMBLY=y

# SNTP
CONFIG_LWIP_SNTP_MAX_SERVERS=1

# TLS for OTA HTTPS
CONFIG_MBEDTLS_CERTIFICATE_BUNDLE=y
CONFIG_MBEDTLS_CERTIFICATE_BUNDLE_DEFAULT_FULL=y

# Stack sizes
CONFIG_PTHREAD_TASK_STACK_SIZE_DEFAULT=8192
CONFIG_ESP_MAIN_TASK_STACK_SIZE=8192

# Logging
CONFIG_LOG_DEFAULT_LEVEL_INFO=y

# Power management (DFS) — ガイドモードの省電力(set_cpu_80mhz)に必要
CONFIG_PM_ENABLE=y
```
